## Config.in
```kconfig
source "$BR2_EXTERNAL_LVGL_RPI4_PATH/package/test_module/Config.in"
source "$BR2_EXTERNAL_LVGL_RPI4_PATH/package/lvgl/Config.in"
source "$BR2_EXTERNAL_LVGL_RPI4_PATH/package/lvgl_app/Config.in"
```

## configs/raspberrypi4_64_lvgl_defconfig
```kconfig
BR2_aarch64=y
BR2_cortex_a72=y
BR2_ARM_FPU_VFPV4=y

BR2_TOOLCHAIN_BUILDROOT_CXX=y

BR2_SYSTEM_DHCP="eth0"

# Linux headers same as kernel, a 6.1 series
BR2_PACKAGE_HOST_LINUX_HEADERS_CUSTOM_6_1=y

BR2_LINUX_KERNEL=y
BR2_LINUX_KERNEL_CUSTOM_TARBALL=y
BR2_LINUX_KERNEL_CUSTOM_TARBALL_LOCATION="$(call github,raspberrypi,linux,17f135b742c4edb340afb365873c3a574f7e16cb)/linux-17f135b742c4edb340afb365873c3a574f7e16cb.tar.gz"
BR2_LINUX_KERNEL_DEFCONFIG="bcm2711"

# Build the DTB from the kernel sources
BR2_LINUX_KERNEL_DTS_SUPPORT=y
BR2_LINUX_KERNEL_INTREE_DTS_NAME="broadcom/bcm2711-rpi-4-b"

BR2_LINUX_KERNEL_NEEDS_HOST_OPENSSL=y

BR2_PACKAGE_RPI_FIRMWARE=y
BR2_PACKAGE_RPI_FIRMWARE_VARIANT_PI4=y
BR2_PACKAGE_RPI_FIRMWARE_CONFIG_FILE="$(BR2_EXTERNAL_LVGL_RPI4_PATH)/board/raspberrypi/config_4_64bit_lvgl.txt"

# Required tools to create the SD image
BR2_PACKAGE_HOST_DOSFSTOOLS=y
BR2_PACKAGE_HOST_GENIMAGE=y
BR2_PACKAGE_HOST_MTOOLS=y

# Filesystem / image
BR2_TARGET_ROOTFS_EXT2=y
BR2_TARGET_ROOTFS_EXT2_4=y
BR2_TARGET_ROOTFS_EXT2_SIZE="120M"
# BR2_TARGET_ROOTFS_TAR is not set
BR2_ROOTFS_POST_BUILD_SCRIPT="$(BR2_EXTERNAL_LVGL_RPI4_PATH)/board/raspberrypi/post-build.sh"
BR2_ROOTFS_POST_IMAGE_SCRIPT="$(BR2_EXTERNAL_LVGL_RPI4_PATH)/board/raspberrypi/post-image.sh"

# Enable compressed kernel module support
BR2_PACKAGE_BUSYBOX_SHOW_OTHERS=y
BR2_PACKAGE_KMOD_TOOLS=y
BR2_PACKAGE_XZ=y
BR2_PACKAGE_KMOD=y
BR2_PACKAGE_HOST_KMOD_XZ=y

# this setting is to enable the DRM
BR2_ROOTFS_DEVICE_CREATION_DYNAMIC_EUDEV=y
BR2_LINUX_KERNEL_NEEDS_HOST_LIBELF=y

# Enabale the libdrm
BR2_PACKAGE_LIBDRM=y
BR2_PACKAGE_LIBDRM_HAS_ATOMIC=y
BR2_PACKAGE_LIBDRM_VC4=y

# set the driectory to rootfs overlay
BR2_ROOTFS_OVERLAY="$(BR2_EXTERNAL_LVGL_RPI4_PATH)/board/raspberrypi/rootfs_overlay"

# Enable the WIFI
BR2_PACKAGE_NETWORK_MANAGER=y
BR2_PACKAGE_NETWORK_MANAGER_CLI=y
BR2_PACKAGE_DBUS=y
BR2_PACKAGE_EUDEV=y
BR2_PACKAGE_WPA_SUPPLICANT=y
BR2_PACKAGE_WPA_SUPPLICANT_WPS=y
BR2_PACKAGE_WPA_SUPPLICANT_WPS3=y
BR2_PACKAGE_WPA_SUPPLICANT_DBUS=y
BR2_PACKAGE_WPA_SUPPLICANT_CLI=y
BR2_PACKAGE_WPA_SUPPLICANT_PASSPHRASE=y
BR2_PACKAGE_IW=y

# Enable the ssh server
BR2_PACKAGE_OPENSSH=y

# Enable mesa3d for the EGLFS which is required for the QT6
BR2_PACKAGE_PROVIDES_LIBEGL="mesa3d"
BR2_PACKAGE_PROVIDES_LIBGLES="mesa3d"
BR2_PACKAGE_MESA3D=y
BR2_PACKAGE_MESA3D_GALLIUM_DRIVER=y
BR2_PACKAGE_MESA3D_DRIVER=y
BR2_PACKAGE_MESA3D_GALLIUM_DRIVER_SWRAST=y
BR2_PACKAGE_MESA3D_GALLIUM_DRIVER_VC4=y
BR2_PACKAGE_MESA3D_GBM=y
BR2_PACKAGE_MESA3D_OPENGL_EGL=y
BR2_PACKAGE_MESA3D_OPENGL_ES=y
BR2_PACKAGE_PROVIDES_LIBGBM="mesa3d"

# Enable the QT6
BR2_PACKAGE_QT6_ARCH_SUPPORTS=y
BR2_PACKAGE_QT6_GL_SUPPORTS=y
BR2_PACKAGE_QT6=y
BR2_PACKAGE_QT6BASE=y
BR2_PACKAGE_QT6BASE_GUI=y
BR2_PACKAGE_QT6BASE_LINUXFB=y
BR2_PACKAGE_QT6BASE_EGLFS=y
BR2_PACKAGE_QT6BASE_DEFAULT_QPA="eglfs"
BR2_PACKAGE_QT6BASE_OPENGL=y
BR2_PACKAGE_QT6BASE_OPENGL_ES2=y
BR2_PACKAGE_QT6BASE_FONTCONFIG=y
BR2_PACKAGE_QT6BASE_GIF=y
BR2_PACKAGE_QT6BASE_JPEG=y
BR2_PACKAGE_QT6BASE_PNG=y
BR2_PACKAGE_QT6BASE_WIDGETS=y
BR2_PACKAGE_QT6BASE_XML=y
BR2_PACKAGE_QT6CORE5COMPAT=y
BR2_PACKAGE_QT6SVG=y


# Set the Locales to en_US.UTF-8
BR2_ENABLE_LOCALE=y
BR2_ENABLE_LOCALE_WHITELIST="C en_US"
BR2_GENERATE_LOCALE="en_US.UTF-8 ko_KR.UTF-8"

# Add the fonts
BR2_PACKAGE_DEJAVU=y
```

## package/lvgl/Config.in
```kconfig
menuconfig BR2_PACKAGE_MENU_LVGL
	bool "LVGL"
	depends on BR2_INSTALL_LIBSTDCPP
	depends on BR2_TOOLCHAIN_GCC_AT_LEAST_8
	depends on BR2_HOST_GCC_AT_LEAST_8
	select BR2_PACKAGE_LVGL
	help
		LVGL: Light and Versatile Graphics Library

		https://github.com/MainForm/buildroot_lvgl_package


if BR2_PACKAGE_MENU_LVGL

config BR2_PACKAGE_LVGL
	bool "LVGL v9.2.2"
	help
		LVGL: Light and Versatile Graphics Library

		https://github.com/MainForm/buildroot_lvgl_package

comment "LVGL graphic Platform"

config BR2_PACKAGE_LVGL_USE_DRM
	bool "DRM support"
	depends on BR2_PACKAGE_LIBDRM
	help
		LVGL use libdrm to draw window

comment "LVGL input library"

config BR2_PACKAGE_LVGL_USE_LIBINPUT
	bool "libinput support"
	depends on BR2_PACKAGE_LIBINPUT
	help
		LVGL use libinput for input device like mouse and keyboard

endif
```

## package/lvgl_app/Config.in
```kconfig
config BR2_PACKAGE_LVGL_APP
	bool "LVGL applications"
	depends on BR2_PACKAGE_LVGL
	help
		LVGL: Light and Versatile Graphics Library

		https://lvgl.io/

comment "LVGL_APP needs an LVGL package"
	depends on !BR2_PACKAGE_LVGL
```

## package/test_module/Config.in
```kconfig
config BR2_PACKAGE_TEST_MODULE
	bool "test_module"
	depends on BR2_LINUX_KERNEL
	help
		This package is to test adding the package that is for kernel module.
```
